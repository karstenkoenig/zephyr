## drivers/can/Kconfig.mcp2515
```kconfig
# Kconfig.mcp2515 - MCP2515 CAN configuration options

#
# Copyright (c) 2018 Karsten Koenig
#
# SPDX-License-Identifier: Apache-2.0
#

config CAN_MCP2515
	bool "MCP2515 CAN Driver"
	default n
	depends on SPI
	help
	  Enable MCP2515 CAN Driver
```

## drivers/can/Kconfig.stm32
```kconfig
# Kconfig.stm32 - STM32 CAN configuration options

#
# Copyright (c) 2018 Alexander Wachter
#
# SPDX-License-Identifier: Apache-2.0
#

config CAN_STM32
	bool "STM32 CAN Driver"
	default n
	select USE_STM32_HAL_CAN
	help
	  Enable STM32 CAN Driver (tested on stm32F0 series)
```

## dts/bindings/can/mcp,mcp2515.yaml
```yaml
---
title: STM32 CAN
id: st,stm32-can
version: 0.1

description: >
    This binding gives a base representation of the STM32 CAN controller

inherits:
    !include can.yaml
    !include spi-device.yaml

properties:
    compatible:
      type: string
      category: required
      description: compatible strings
      constraint: "mcp,mcp2515"

...
```
